#include <Wire.h>
#include <Adafruit_GFX.h>
#include <Adafruit_SSD1306.h>
#include <TM1637Display.h>
#include <WiFi.h>
#include <HTTPClient.h>
#include <ArduinoJson.h>
#include <ESPping.h>
#include <time.h>

#define SCREEN_WIDTH 128
#define SCREEN_HEIGHT 64
#define OLED_RESET    -1
#define SCREEN_ADDRESS 0x3C

#define CLK 25
#define DIO 26

const char* ssid = "TP-Link_2A";
const char* password = "30755550";

const char* weatherUrl = "APIKEY";

Adafruit_SSD1306 display(SCREEN_WIDTH, SCREEN_HEIGHT, &Wire, OLED_RESET);
TM1637Display tm(CLK, DIO);

String input = "";
float outtemp = 0.0;
float roomtemp = 0.0;
float avgPing = 0.0;
int displayTime;
String dateStr = "00/00/00";
long rssi = 0;

unsigned long lastWeatherUpdate = 0;
const unsigned long weatherUpdateInterval = 600000;

void updateTime() {
  struct tm timeinfo;
  if (getLocalTime(&timeinfo)) {
    char buf[9];
    sprintf(buf, "%02d/%02d/%02d", timeinfo.tm_mday, timeinfo.tm_mon+1, timeinfo.tm_year % 100);
    dateStr = buf;
    displayTime = (timeinfo.tm_hour * 100) + timeinfo.tm_min;
  }
}

uint8_t customEncode(uint8_t displayTime) {
  switch(displayTime) {
    case 0: return 0b11100111;
    case 1: return 0b10000100;
    case 2: return 0b11010011;
    case 3: return 0b11010110;
    case 4: return 0b10110100;
    case 5: return 0b01110110;
    case 6: return 0b01110111;
    case 7: return 0b11000100;
    case 8: return 0b11110111;
    case 9: return 0b11110110;
  }
  return 0;
}

void setupWiFi() {
  WiFi.mode(WIFI_STA);
  WiFi.begin(ssid, password);
  int attempts = 0;
  while (WiFi.status() != WL_CONNECTED && attempts < 20) {
    delay(500);
    attempts++;
  }
}

void fetchWeather() {
  if (WiFi.status() != WL_CONNECTED) {
    outtemp = 00;
    return;
  }
  HTTPClient http;
  http.setConnectTimeout(5000);
  http.setTimeout(5000);
  if (!http.begin(weatherUrl)) return;
  int httpCode = http.GET();
  if (httpCode == 200) {
    String payload = http.getString();
    DynamicJsonDocument doc(2048);
    DeserializationError error = deserializeJson(doc, payload);
    if (!error) {
      outtemp = doc["main"]["temp"];
    } else {
      outtemp = 00;
    }
  } else {
    outtemp = -999;
  }
  http.end();
}

void setup() {
  Serial.begin(115200);
  if(!display.begin(SSD1306_SWITCHCAPVCC, SCREEN_ADDRESS)) for(;;);
  display.setRotation(2);
  tm.setBrightness(7);
  setupWiFi();
  configTime(0, 0, "pool.ntp.org");
  setenv("TZ", "CET-1CEST,M3.5.0,M10.5.0/3", 1);
  tzset();
}

void loop() {
  if (millis() - lastWeatherUpdate > weatherUpdateInterval) {
    fetchWeather();
    lastWeatherUpdate = millis();
  }

  if (Ping.ping("192.168.0.1", 3)) {
    avgPing = Ping.averageTime();
  } else {
    avgPing = -1;
  }

  updateTime();

long rssi = WiFi.RSSI();   // <-- add here

// Display time using your custom bytes
  uint8_t data[4] = {0,0,0,0};
  int temp = displayTime;
  for(int i = 3; i >= 0; i--) {
    data[3-i] = customEncode(temp % 10);
    temp /= 10;
  }
  tm.setSegments(data);
  while(Serial.available()) {
    char c = Serial.read();
    if(c == '\n' || c == '\r') {
      if(input.length() > 0) {
        uint8_t data[4] = {0,0,0,0};
        for(int i = 0; i < 4 && i < input.length(); i++) {
          if(input[i] >= '0' && input[i] <= '9') {
            data[3-i] = customEncode(input[i] - '0');
            
          }
        }
        tm.setSegments(data);
        input = "";
      }
    } else input += c;
  }

  int adc = analogRead(34);
  roomtemp = 3 + (2020 - adc) * 0.06;
  
    display.clearDisplay();
    display.setTextColor(SSD1306_WHITE);

static const unsigned char PROGMEM image_arrow_curved_down_left_bits[] = {0x20,0x10,0x10,0x18,0xb8,0xf0,0xe0,0xf0};

static const unsigned char PROGMEM image_klepsydra_bits[] = {0xff,0x42,0x42,0x24,0x18,0x18,0x24,0x42,0x42,0xff};

static const unsigned char PROGMEM image_music_radio_streaming_bits[] = {0x00,0x00,0x00,0x00,0x00,0x00,0x20,0x02,0x00,0x40,0x01,0x00,0x48,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0x00,0x00};

static const unsigned char PROGMEM image_paint_13_bits[] = {0x00,0x20,0x00,0x00,0x0f,0xe0,0x00,0x00,0x07,0x20,0x00,0x00,0x03,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0x00,0x00};

static const unsigned char PROGMEM image_paint_14_bits[] = {0xa0,0xa0,0xa0,0xa0,0xa0,0xa0,0xa0,0xa0,0xa0,0xa0,0xa0,0xa1,0xb0};

static const unsigned char PROGMEM image_paint_15_bits[] = {0x80,0x00,0x00,0x00,0x00,0x00,0x00,0x00,0x00,0x00,0x00,0x00,0x02,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0x00,0x00};

static const unsigned char PROGMEM image_paint_16_bits[] = {0x80};

static const unsigned char PROGMEM image_paint_18_bits[] = {0x80,0x00,0x00,0x00,0x00,0x20};

static const unsigned char PROGMEM image_paint_19_bits[] = {0x00,0x00,0x00,0x00,0x00,0x00,0x20,0x00,0x00,0x00,0x00,0x00,0x00,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0x00,0x00};

static const unsigned char PROGMEM image_paint_24_bits[] = {0x04,0x00,0x00,0x00,0x00,0x0f,0x80,0x00,0x00,0x00,0x1f,0xe0,0x00,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0x00,0x00};

static const unsigned char PROGMEM image_paint_28_bits[] = {0x00,0x18,0x00,0x00,0x00,0x00,0x38,0x00,0x00,0x00,0x00,0x3e,0x00,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0x00,0x00};

static const unsigned char PROGMEM image_paint_29_bits[] = {0x20,0x00,0x00,0x20,0x00,0x00,0x20,0x60,0xe0,0xe0};

static const unsigned char PROGMEM image_paint_31_bits[] = {0x00};

static const unsigned char PROGMEM image_paint_32_bits[] = {0xff,0xff,0xff,0xc0};

static const unsigned char PROGMEM image_paint_36_bits[] = {0x04,0x06,0x02,0x62,0xfe};

static const unsigned char PROGMEM image_paint_8_bits[] = {0x00,0x0f,0x00,0x00,0x1f,0x00,0x00,0x3f,0xc0,0x03,0xbf,0xc0,0x07,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0x00,0x00};


display.drawLine(-1, 14, 128, 14, 1);

display.drawLine(0, 47, 128, 47, 1);

display.drawCircle(29, 25, 4, 1);

display.drawCircle(34, 30, 4, 1);

display.drawCircle(23, 28, 4, 1);

display.drawCircle(18, 30, 3, 1);

display.drawLine(19, 34, 33, 34, 1);

display.drawBitmap(16, 22, image_paint_8_bits, 22, 13, 1);

display.setTextColor(1);
display.setTextWrap(false);
display.setCursor(44, 26);
display.print(outtemp);
display.print("C");

display.drawRect(75, 21, 4, 14, 1);

display.drawCircle(76, 38, 3, 1);

display.drawLine(74, 21, 74, 33, 1);

display.drawBitmap(68, 20, image_paint_13_bits, 27, 15, 0);

display.drawBitmap(75, 22, image_paint_14_bits, 8, 13, 1);

display.drawBitmap(66, 21, image_paint_15_bits, 36, 16, 0);

display.drawBitmap(66, 21, image_paint_16_bits, 1, 1, 1);

display.setCursor(82, 26);
display.print(roomtemp);
display.print("C");


display.drawBitmap(66, 19, image_paint_18_bits, 11, 3, 1);

display.drawBitmap(38, -22, image_paint_19_bits, 62, 45, 0);

display.drawCircle(9, 49, 1, 0);

display.drawCircle(9, 56, 5, 1);

display.drawCircle(9, 56, 3, 1);

display.drawCircle(9, 56, 1, 1);

display.drawBitmap(3, 50, image_paint_24_bits, 39, 13, 0);

display.drawCircle(13, 60, 9, 1);

display.drawCircle(14, 61, 7, 1);

display.drawCircle(13, 60, 3, 1);

display.drawBitmap(3, 50, image_paint_28_bits, 34, 13, 0);

display.drawBitmap(11, 51, image_paint_29_bits, 3, 10, 1);

display.drawBitmap(21, 63, image_paint_16_bits, 1, 1, 1);

display.drawBitmap(0, 0, image_paint_31_bits, 1, 1, 1);

display.drawBitmap(0, 63, image_paint_32_bits, 26, 1, 0);

display.setCursor(15, 53);
display.print("TP-Link_2A");

display.drawBitmap(61, 21, image_paint_16_bits, 1, 1, 1);

display.drawBitmap(60, 18, image_paint_36_bits, 7, 5, 0);

display.drawBitmap(5, 2, image_klepsydra_bits, 8, 10, 1);

display.setCursor(15, 3);
display.print(dateStr);

display.drawBitmap(71, 3, image_arrow_curved_down_left_bits, 5, 8, 1);

display.setCursor(78, 4);
display.print(avgPing);  
display.print("ms");

display.drawBitmap(78, 50, image_music_radio_streaming_bits, 17, 16, 1);

display.setCursor(97, 53);
display.print(rssi);
display.print("dB");  //powinno byc dbm ale sie nie miesci

display.display();

Serial.println(displayTime);
Serial.println(dateStr);

  delay(100);
}
